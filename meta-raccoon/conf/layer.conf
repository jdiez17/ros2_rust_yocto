## meta-raccoon/conf/layer.conf
```bitbake
# We have a conf and classes directory, add to BBPATH
BBPATH .= ":${LAYERDIR}"

# We have recipes-* directories, add to BBFILES
BBFILES += "${LAYERDIR}/recipes-*/*/*.bb \
            ${LAYERDIR}/recipes-*/*/*.bbappend"

BBFILE_COLLECTIONS += "meta-raccoon"
BBFILE_PATTERN_meta-raccoon = "^${LAYERDIR}/"
BBFILE_PRIORITY_meta-raccoon = "6"

LAYERDEPENDS_meta-raccoon = "core"
LAYERSERIES_COMPAT_meta-raccoon = "mickledore"
```
